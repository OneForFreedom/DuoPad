/ {
    keymap {
        compatible = "zmk,keymap";

        layers {
            default_layer {
                bindings = <
                    &kp UP      &kp LEFT    &kp DOWN    &kp RIGHT   &kp SPACE
                    &enc_vol_up &enc_vol_dn &enc_mute
                >;
            };
        };
    };
};
